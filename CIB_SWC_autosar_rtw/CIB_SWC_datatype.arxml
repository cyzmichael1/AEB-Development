AUTOSAR XML (schema 4-3-0)
standard types defined: Boolean, UInt16, UInt8, Double, UInt32, SInt32, SInt8, SInt16, boolean, uint16, uint8, float64, uint32, sint32, sint8, sint16
package /CIB_SWC_pkg/CIB_SWC_dt
  impl type Diag: category=STRUCTURE
    56 x element, all with category=TYPE_REFERENCE:
      Allow_ACC: implementation-data-type=Boolean
      Allow_FCA: implementation-data-type=Boolean
      Allow_CIB: implementation-data-type=Boolean
      Allow_FDI: implementation-data-type=Boolean
      Allow_LKA: implementation-data-type=Boolean
      Allow_LDW: implementation-data-type=Boolean
      Allow_LCA: implementation-data-type=Boolean
      Driver_Pressing_FCA_Brake_Pedal: implementation-data-type=Boolean
      Driver_Pressing_Brake_Pedal: implementation-data-type=Boolean
      Driver_Commanded_Disengagement: implementation-data-type=Boolean
      Service_Radar_Cruise_State: implementation-data-type=Boolean
      Clean_Radar_State: implementation-data-type=Boolean
      Cruise_Not_Ready_State: implementation-data-type=Boolean
      Clean_Camera_State: implementation-data-type=Boolean
      Allow_ACC_Magic: implementation-data-type=UInt16
      Request_HUD_Off_Warning: implementation-data-type=Boolean
      OverSpeed_Flag: implementation-data-type=Boolean
      Brake_Before_Cruise_Message: implementation-data-type=Boolean
      CIB_Unavailable_State: implementation-data-type=Boolean
      SensorPlausibilityActiveFault: implementation-data-type=Boolean
      Speed_Compare_Fault_Active: implementation-data-type=Boolean
      FCA_Driver_Disable: implementation-data-type=Boolean
      FCA_Temp_Unavailable: implementation-data-type=Boolean
      DriverBraking_CIB_Confirm: implementation-data-type=Boolean
      LKA_Temp_Unavailable: implementation-data-type=Boolean
      LCA_Temp_Unavailable: implementation-data-type=Boolean
      LDW_Temp_Unavailable: implementation-data-type=Boolean
      SPC_Inprogress: implementation-data-type=Boolean
      TJA_goto_Fail: implementation-data-type=Boolean
      Allow_TJA: implementation-data-type=Boolean
      Allow_ELK: implementation-data-type=Boolean
      Allow_AHBC: implementation-data-type=Boolean
      Allow_TSR: implementation-data-type=Boolean
      Allow_ILC: implementation-data-type=Boolean
      brake_ped_travl_this_ign_cycle: implementation-data-type=Boolean
      Allow_ACC_Except_TJA: implementation-data-type=Boolean
      AHBC_Sys_Fault: implementation-data-type=Boolean
      ACC_Disengage_Request: implementation-data-type=Boolean
      NonAPTIV_TJA_Engaged: implementation-data-type=Boolean
      TSR_Sys_Fault: implementation-data-type=Boolean
      TSR_Temp_Unavailable: implementation-data-type=Boolean
      AHBC_Temp_Unavailable: implementation-data-type=Boolean
      ELK_Temp_Unavailable: implementation-data-type=Boolean
      ILC_Temp_Unavailable: implementation-data-type=Boolean
      Clean_FLSRR_State: implementation-data-type=Boolean
      Clean_FRSRR_State: implementation-data-type=Boolean
      Clean_RLSRR_State: implementation-data-type=Boolean
      Clean_RRSRR_State: implementation-data-type=Boolean
      FrontSRR_DegradeMode: implementation-data-type=Boolean
      RearSRR_DegradeMode: implementation-data-type=Boolean
      FrontCamera_DegradeMode: implementation-data-type=Boolean
      FrontMRR_DegradeMode: implementation-data-type=Boolean
      Allow_LongCtrlSS: implementation-data-type=Boolean
      AptivDiag_ARC: implementation-data-type=UInt8
      Allow_LatCtrlSS: implementation-data-type=Boolean
      Allow_LatCtrlSS_MRRFail: implementation-data-type=Boolean
  compu method COMPU_Boolean: 0=FALSE, 1=TRUE
  unit NoUnit: factor-si-to-unit=1, offset-si-to-unit=0
  17 x impl type:
    ACC: category=STRUCTURE
      98 x element, all with category=TYPE_REFERENCE:
        ACC_Mode: implementation-data-type=UInt8
        ACC_Mode_n_1: implementation-data-type=UInt8
        ACCATC_ACCAct: implementation-data-type=Boolean
        ACCA_State: implementation-data-type=UInt8
        ACCA_State_n_1: implementation-data-type=UInt8
        ACCATC_SplREngInpR: implementation-data-type=Boolean
        ACCATC_DrvAstdGoSt: implementation-data-type=UInt8
        ACCATC_ACCtyp: implementation-data-type=UInt8
        Go_Notifier_Request: implementation-data-type=Boolean
        Speed_Control_Active: implementation-data-type=Boolean
        QA_Radiating_Request: implementation-data-type=Boolean
        Speed_Control_Active_n_1: implementation-data-type=Boolean
        ACC_Type: implementation-data-type=UInt8
        ResumePressGoEnable: implementation-data-type=Boolean
        Throttle_Resume_OK: implementation-data-type=Boolean
        Auto_Resume_OK: implementation-data-type=Boolean
        Engage_Attempted: implementation-data-type=Boolean
        Disengagement_Occurred: implementation-data-type=Boolean
        Automatic_Disengagement: implementation-data-type=Boolean
        Driver_Requested_Disengagement: implementation-data-type=Boolean
        AptivACCSWC_ARC: implementation-data-type=UInt8
        Set_Speed_Corrupted: implementation-data-type=Boolean
        Speed_Error_For_Inhibit_mps_n_1: implementation-data-type=Double
        ACC_AcclrtnReq: implementation-data-type=Double
        ACCATC_AxlTrqRq: implementation-data-type=Double
        ACCBSC_ACCAccl: implementation-data-type=Double
        Max_Decel_Warning: implementation-data-type=Boolean
        ACCBSC_AutoBrkReqd: implementation-data-type=Boolean
        ACCBSC_AutoBrkReqd_n_1: implementation-data-type=Boolean
        ACCBSCE_AutBrkTp: implementation-data-type=UInt8
        ACCBSCE_ACCAct: implementation-data-type=Boolean
        Raw_Accel: implementation-data-type=Double
        Desired_Speed: implementation-data-type=Double
        Allowed_Speed: implementation-data-type=Double
        Allowed_Accel: implementation-data-type=Double
        Allowed_Jerk: implementation-data-type=Double
        Tight_Curve: implementation-data-type=Boolean
        Speed_Limit_Max: implementation-data-type=Double
        Speed_Limit_Min: implementation-data-type=Double
        Accel_Limit_Max: implementation-data-type=Double
        Accel_Limit_Min: implementation-data-type=Double
        Jerk_Limit_Max: implementation-data-type=Double
        Jerk_Limit_Min: implementation-data-type=Double
        Speed_Error_For_Limiter_mps: implementation-data-type=Double
        speed_error_for_engine_mps: implementation-data-type=Double
        I_term_engine: implementation-data-type=Double
        speed_error_for_brake_mps: implementation-data-type=Double
        I_term_brake: implementation-data-type=Double
        P_term_brake: implementation-data-type=Double
        initialize_I_term_brake: implementation-data-type=Boolean
        I_term_brake_init_value: implementation-data-type=Double
        freeze_I_term_brake: implementation-data-type=Boolean
        P_term_engine: implementation-data-type=Double
        initialize_I_term_engine: implementation-data-type=Boolean
        freeze_I_term_engine: implementation-data-type=Boolean
        I_term_engine_init_value: implementation-data-type=Double
        Overspeed_Decel_Active: implementation-data-type=Boolean
        bypass_the_limiter: implementation-data-type=Boolean
        Feed_forward_LV_Accel: implementation-data-type=Double
        Delta_Speed_Desired: implementation-data-type=Double
        speed_limited_max: implementation-data-type=Boolean
        speed_limited_min: implementation-data-type=Boolean
        accel_limited_max: implementation-data-type=Boolean
        accel_limited_min: implementation-data-type=Boolean
        jerk_limited_max: implementation-data-type=Boolean
        jerk_limited_min: implementation-data-type=Boolean
        engine_at_min_torque_flags: implementation-data-type=UInt32
        freeze_engine_integrator_flags: implementation-data-type=UInt32
        Accel_Command_To_Brake: implementation-data-type=Double
        desired_accel: implementation-data-type=Double
        desired_accel_unfiltered: implementation-data-type=Double
        limited_desired_speed: implementation-data-type=Double
        Biased_Range: implementation-data-type=Double
        Raw_Accel_Modified: implementation-data-type=Double
        Accel_After_Override_Selected: implementation-data-type=Boolean
        Raw_Accel_Unmodified: implementation-data-type=Double
        Feed_forward_LV_Accel_CIPV2: implementation-data-type=Double
        Delta_Speed_Desired_CIPV2: implementation-data-type=Double
        accel_command_CIPV2: implementation-data-type=Double
        Init_Allowed_Speed: implementation-data-type=Boolean
        engine_at_min_torque: implementation-data-type=Boolean
        CRLT_Jerk_Timer_Active: implementation-data-type=Boolean
        Accel_Command_To_Engine: implementation-data-type=Double
        bypass_engine_output_filter: implementation-data-type=Boolean
        Desired_Range: implementation-data-type=Double
        DSDforPosLVAccelSelected: implementation-data-type=Boolean
        LV_Accel_Low_Noise: implementation-data-type=Double
        dropped_target_timer: implementation-data-type=UInt32
        Road_Grade_Accel_Modified: implementation-data-type=Double
        Lat_Accel_Limit_Active: implementation-data-type=Boolean
        limited_desired_accel: implementation-data-type=Double
        hold_accel_in_curve_time: implementation-data-type=Double
        TJA_Override_ACCDecel: implementation-data-type=Boolean
        Delta_Speed_Desired_CutInV: implementation-data-type=Double
        accel_command_CutInV: implementation-data-type=Double
        Feed_forward_LV_Accel_CutInV: implementation-data-type=Double
        Overtake_Aid_Accel_Selected: implementation-data-type=Boolean
        Curve_SpeedLimit_Active: implementation-data-type=Boolean
    VCAN: category=STRUCTURE
      206 x element, all with category=TYPE_REFERENCE:
        AccActPos: implementation-data-type=Double
        AccActPosV: implementation-data-type=Boolean
        ABSAtv: implementation-data-type=Boolean
        ACC_PTAccReqSprcd: implementation-data-type=Boolean
        ACCATCS_LmtgStat: implementation-data-type=UInt8
        ACCATCS_RqStat: implementation-data-type=UInt8
        ACCBrkngAct: implementation-data-type=Boolean
        AccPdlOvrrdAtv: implementation-data-type=Boolean
        ActVehAccel: implementation-data-type=Double
        ActVehAccelV: implementation-data-type=Boolean
        AdptCrsGapSwAct: implementation-data-type=UInt8
        AirbgVDA: implementation-data-type=Boolean
        AutoBrkngAct: implementation-data-type=Boolean
        AutoTransComndGear: implementation-data-type=UInt8
        BksOvht: implementation-data-type=Boolean
        BPDAPS_BkPDrvApP: implementation-data-type=UInt16
        BrkAppSnsrHmPosLrnd: implementation-data-type=Boolean
        BrkPdlDrvAppPrsDetcd: implementation-data-type=Boolean
        BrkPdlDrvAppPrsDetcdV: implementation-data-type=Boolean
        BrkPdlPos: implementation-data-type=Double
        BrkPedTrvlAchvd: implementation-data-type=Boolean
        BrkPedTrvlAchvdV: implementation-data-type=Boolean
        BrkSysAutBrkFld: implementation-data-type=Boolean
        ChmMstrVDA: implementation-data-type=Boolean
        ColPrSysCustReq: implementation-data-type=UInt8
        CrsCntEnbld: implementation-data-type=Boolean
        CrsCntrlSwStCanSwAct: implementation-data-type=Boolean
        CrsCntrlSwStOnSwAct: implementation-data-type=Boolean
        CrsCntrlSwStResSwAct: implementation-data-type=Boolean
        CrsCntrlSwStSetSwAct: implementation-data-type=Boolean
        CrsCntrlSwStSpDcSwAct: implementation-data-type=Boolean
        CrsCntrlSwStSpdInSwAct: implementation-data-type=Boolean
        CrsCntrlSwStSwDataIntgty: implementation-data-type=UInt8
        CrshAlrtDrvrSlctdType: implementation-data-type=Boolean
        CrshAlrtStPrsnt: implementation-data-type=Boolean
        CrsSecSwStat: implementation-data-type=UInt8
        CrsSpdLmtrSwStat: implementation-data-type=UInt8
        CSETRER_TqIntvnTyp: implementation-data-type=UInt8
        DDAjrSwAtvM: implementation-data-type=Boolean
        DDAjrSwAtv: implementation-data-type=Boolean
        DispMeasSys: implementation-data-type=Boolean
        DrSbltAtc: implementation-data-type=Boolean
        DrSbltAtcV: implementation-data-type=Boolean
        DrvIntndAxlTrq: implementation-data-type=SInt32
        DrvIntndAxlTrqMax: implementation-data-type=SInt32
        DrvIntndAxlTrqMin: implementation-data-type=SInt32
        ElecPrkBrkStat: implementation-data-type=UInt8
        EngRunAtv: implementation-data-type=Boolean
        EngSpd: implementation-data-type=Double
        EngSpdStat: implementation-data-type=UInt8
        EngTrqActExtRng: implementation-data-type=Double
        EngTrqDrRqdExtRng: implementation-data-type=Double
        EngTrqMaxExtRng: implementation-data-type=Double
        EngTrqMinExtRng: implementation-data-type=Double
        EPBCrsCanRq: implementation-data-type=Boolean
        FSpRgACCSwADd: implementation-data-type=Boolean
        FwdClnAlrtCustStngReq: implementation-data-type=UInt8
        GNCustStngReq: implementation-data-type=UInt8
        HapticSeatVDA: implementation-data-type=Boolean
        Headlamp_Status: implementation-data-type=Boolean
        HeadUpDispVDA: implementation-data-type=Boolean
        HillDscntCtrlStat: implementation-data-type=UInt8
        HndsOffMode: implementation-data-type=UInt8
        HndsOffState: implementation-data-type=Boolean
        HndsOffStateValid: implementation-data-type=Boolean
        HptcStVbnStat: implementation-data-type=UInt8
        HUDActv: implementation-data-type=Boolean
        IPCVDA: implementation-data-type=Boolean
        LKATrqOvrlTrqDStat: implementation-data-type=UInt8
        PltfrmEngSpdCmdMdAct: implementation-data-type=Boolean
        PrkAstAdvSysAct: implementation-data-type=Boolean
        PrkBrkSwAtv: implementation-data-type=Boolean
        PT_BrkPedDscrtInpStat: implementation-data-type=Boolean
        PT_BrkPedDscrtInpStatV: implementation-data-type=Boolean
        RdLdNomAxlTrq: implementation-data-type=Double
        SecAxlOperMod: implementation-data-type=UInt8
        SecAxlStat: implementation-data-type=UInt8
        SIRDpl: implementation-data-type=Boolean
        StWhAnVDA: implementation-data-type=Boolean
        StrWhAng_Pri: implementation-data-type=Double
        StrWhAngGrd: implementation-data-type=Double
        StrWhAngGrdV: implementation-data-type=Boolean
        StrWhlAngSenCalStat: implementation-data-type=UInt8
        SysBkUpPwrMd: implementation-data-type=UInt8
        SysBkupPwrMdEn: implementation-data-type=Boolean
        SysPwrMd: implementation-data-type=UInt8
        TCSysAtv: implementation-data-type=Boolean
        TCSysOpMd: implementation-data-type=UInt8
        TCSysOpStat: implementation-data-type=UInt8
        TopTrvlCltchSwAct: implementation-data-type=Boolean
        TopTrvlCltchSwActV: implementation-data-type=Boolean
        TransEstGear: implementation-data-type=UInt8
        TransTUDMdStat: implementation-data-type=UInt8
        TrnsEngdState: implementation-data-type=UInt8
        DirectionIndSwitchPos: implementation-data-type=UInt8
        VehMassNom: implementation-data-type=UInt16
        VehOdo: implementation-data-type=Double
        VehOdoV: implementation-data-type=Boolean
        VehSpdAvgDrvn: implementation-data-type=Double
        VehSpdAvgDrvnV: implementation-data-type=Boolean
        VehSpdAvgNDrvn: implementation-data-type=Double
        VehSpdAvgNDrvnV: implementation-data-type=Boolean
        VehStabEnhmntMd: implementation-data-type=UInt8
        VehStabEnhmntStat: implementation-data-type=UInt8
        VhDynCntlSysSt: implementation-data-type=UInt8
        VSEAct: implementation-data-type=Boolean
        WhlDistPrRevDrvn: implementation-data-type=UInt16
        WhlGrndVlctyLftDrvn: implementation-data-type=Double
        WhlGrndVlctyLftDrvnV: implementation-data-type=Boolean
        WhlGrndVlctyLftNnDrvn: implementation-data-type=Double
        WhlGrndVlctyLftNnDrvnV: implementation-data-type=Boolean
        WhlGrndVlctyRtDrvn: implementation-data-type=Double
        WhlGrndVlctyRtDrvnV: implementation-data-type=Boolean
        WhlGrndVlctyRtNnDrvn: implementation-data-type=Double
        WhlGrndVlctyRtNnDrvnV: implementation-data-type=Boolean
        WhlRotDrctnlStLftDrvn: implementation-data-type=UInt8
        WhlRotDrctnlStLfNDrvn: implementation-data-type=UInt8
        WhlRotDrctnlStRtDrvn: implementation-data-type=UInt8
        WhlRotDrctnlSRtNDrvn: implementation-data-type=UInt8
        WRSLDWhlDistPlsCntr: implementation-data-type=UInt16
        WRSLDWhlDistVal: implementation-data-type=Boolean
        WRSLNDWhlDistPCntr: implementation-data-type=UInt16
        WRSLNDWhlDistVal: implementation-data-type=Boolean
        WRSRDWhlDistPlsCntr: implementation-data-type=UInt16
        WRSRDWhlDistVal: implementation-data-type=Boolean
        WRSRNDWhlDistPCntr: implementation-data-type=UInt16
        WRSRNDWhlDistVal: implementation-data-type=Boolean
        WSWprAct: implementation-data-type=Boolean
        WSWshSwAtv: implementation-data-type=Boolean
        SysPwrMdV: implementation-data-type=Boolean
        SysBkUpPwrMdV: implementation-data-type=Boolean
        BrkSysAutBrkStat: implementation-data-type=UInt8
        BrkSysExtHldCpbltyFld: implementation-data-type=Boolean
        FSRACCBrkngReqDenied: implementation-data-type=Boolean
        IMULatAccPrim: implementation-data-type=Double
        IMULatAccPrimV: implementation-data-type=Boolean
        IMULonAccPri: implementation-data-type=Double
        IMULonAccPriV: implementation-data-type=Boolean
        IMULonAccPriAval: implementation-data-type=Boolean
        IMUPriYawDrftTyp: implementation-data-type=Boolean
        IMUYawRtPri: implementation-data-type=Double
        IMUYawRtPriV: implementation-data-type=Boolean
        VehMvngStat: implementation-data-type=Boolean
        PedColPrSysCustReq: implementation-data-type=UInt8
        GearLeverPos: implementation-data-type=UInt8
        TorsionBarTorque: implementation-data-type=Double
        LDPMode: implementation-data-type=UInt8
        MaxEngTorqNormal: implementation-data-type=Double
        RPM_Ratio: implementation-data-type=Double
        TJA_ACC_SelSts_Disp: implementation-data-type=UInt8
        TJA_Select: implementation-data-type=Boolean
        WindShieldWiperActSts: implementation-data-type=Boolean
        CollPrepSysInhbt: implementation-data-type=Boolean
        StrWhAng_Sec: implementation-data-type=Double
        IMUYawRtSec: implementation-data-type=Double
        IMULatACCSec: implementation-data-type=Double
        IMULonAccSec: implementation-data-type=Double
        WRSRDWhlDistPlsCntr_Sec: implementation-data-type=UInt16
        WRSLDWhlDistPlsCntr_Sec: implementation-data-type=UInt16
        WRSRNDWhlDistPCntr_Sec: implementation-data-type=UInt16
        WRSLNDWhlDistPCntr_Sec: implementation-data-type=UInt16
        TSRWarnSwtReq: implementation-data-type=Boolean
        TSRSwtReq: implementation-data-type=Boolean
        FrontFogLmpSts: implementation-data-type=Boolean
        HiLowBeamSwtdSts: implementation-data-type=Boolean
        AHBC_ONOFF_SWITCH: implementation-data-type=Boolean
        LSS_SnvtySet: implementation-data-type=UInt8
        ACCSettingType: implementation-data-type=UInt8
        AutoMdSpdLmtCnfrmd: implementation-data-type=Boolean
        AutoSetSpdDisp: implementation-data-type=Boolean
        MAPSpdLimSts: implementation-data-type=UInt8
        MAPSpdLim: implementation-data-type=UInt8
        EPS_SteerMod: implementation-data-type=UInt8
        CIBBrkngAct: implementation-data-type=Boolean
        TSR_SnvtySet: implementation-data-type=SInt8
        HazardLightSts: implementation-data-type=Boolean
        HazardLightSwSts: implementation-data-type=Boolean
        RstrCustFctrDef: implementation-data-type=Boolean
        CrossColPrSysCustReq: implementation-data-type=UInt8
        AutoLightCtrlSt: implementation-data-type=Boolean
        CCO_Active: implementation-data-type=Boolean
        HazardLightRealSts: implementation-data-type=Boolean
        ACC_DrivingMode: implementation-data-type=UInt8
        SHIFT_IN_PROGRESS: implementation-data-type=Boolean
        EspFuncOffSts_Out: implementation-data-type=Boolean
        CDD_Available_Out: implementation-data-type=Boolean
        Eco_plus_mode: implementation-data-type=Boolean
        Vehicle_Max_Spd_Limit: implementation-data-type=UInt8
        FCW_SnvtySet: implementation-data-type=UInt8
        LeftTurnLampFaultSt: implementation-data-type=Boolean
        RightTurnLampFaultSt: implementation-data-type=Boolean
        AptivVI_ARC: implementation-data-type=UInt8
        HOD_Error: implementation-data-type=Boolean
        HOD_Status: implementation-data-type=UInt8
        LSSWarnFormSwtReq: implementation-data-type=UInt8
        IntelligentEvaSwtReq: implementation-data-type=Boolean
        LSSSwtReq: implementation-data-type=Boolean
        TirePres_Nok: implementation-data-type=Boolean
        LCKSwtReq: implementation-data-type=Boolean
        LKASwtReq: implementation-data-type=Boolean
        LDWSwtReq: implementation-data-type=Boolean
        WhlDirNonForwardflag: implementation-data-type=Boolean
        ABSESP_Actv_Lateral: implementation-data-type=Boolean
        AEBBAActive: implementation-data-type=Boolean
        AEBIBActive: implementation-data-type=Boolean
        RearFogLmpStatus: implementation-data-type=Boolean
    HandCode_To_AEB: category=STRUCTURE
      6 x element, all with category=TYPE_REFERENCE:
        Host_Width: implementation-data-type=Double
        JA_PedColPrSysCrntStng: implementation-data-type=UInt8
        JA_ColPrSysCrntStng: implementation-data-type=UInt8
        PedColPrSysCrntStng: implementation-data-type=UInt8
        ColPrSysCrntStng: implementation-data-type=UInt8
        Yaw_Rate_Compensated: implementation-data-type=Double
    target_of_interest: category=STRUCTURE
      element CMbBCIPV: implementation-data-type=CMbBCIPV
      element CMbBCIPS: implementation-data-type=CMbBCIPS
    CMbBCIPV: category=STRUCTURE
      18 x element, all with category=TYPE_REFERENCE:
        CMbBCIPV_TrackID: implementation-data-type=UInt8
        CMbBCIPV_Range: implementation-data-type=Double
        CMbBCIPV_RangeRate: implementation-data-type=Double
        CMbBCIPV_RangeAccel: implementation-data-type=Double
        CMbBCIPV_Angle: implementation-data-type=Double
        CMbBCIPV_LatPos: implementation-data-type=Double
        CMbBCIPV_LatRate: implementation-data-type=Double
        CMbBCIPV_Status: implementation-data-type=UInt8
        CMbBCIPV_Obj_Class: implementation-data-type=UInt8
        CMbBCIPV_Width: implementation-data-type=Double
        CMbBCIPV_Amplitude: implementation-data-type=SInt8
        CMbBCIPV_Match_Conf: implementation-data-type=UInt8
        CMbBCIPV_Movement: implementation-data-type=UInt8
        CMbBCIPV_DetectionSensor: implementation-data-type=UInt8
        CMbBCIPV_VisID: implementation-data-type=UInt8
        CMbBCIPV_Age: implementation-data-type=UInt8
        CMbBCIPV_LeadVel: implementation-data-type=Double
        CMbBCIPV_LeadAccel: implementation-data-type=Double
    CMbBCIPS: category=STRUCTURE
      18 x element, all with category=TYPE_REFERENCE:
        CMbBCIPS_TrackID: implementation-data-type=UInt8
        CMbBCIPS_Range: implementation-data-type=Double
        CMbBCIPS_RangeRate: implementation-data-type=Double
        CMbBCIPS_RangeAccel: implementation-data-type=Double
        CMbBCIPS_Angle: implementation-data-type=Double
        CMbBCIPS_LatPos: implementation-data-type=Double
        CMbBCIPS_LatRate: implementation-data-type=Double
        CMbBCIPS_Status: implementation-data-type=UInt8
        CMbBCIPS_Obj_Class: implementation-data-type=UInt8
        CMbBCIPS_Width: implementation-data-type=Double
        CMbBCIPS_Amplitude: implementation-data-type=SInt8
        CMbBCIPS_Match_Conf: implementation-data-type=UInt8
        CMbBCIPS_Movement: implementation-data-type=UInt8
        CMbBCIPS_DetectionSensor: implementation-data-type=UInt8
        CMbBCIPS_VisID: implementation-data-type=UInt8
        CMbBCIPS_Age: implementation-data-type=UInt8
        CMbBCIPS_LeadVel: implementation-data-type=Double
        CMbBCIPS_LeadAccel: implementation-data-type=Double
    HSP: category=STRUCTURE
      118 x element, all with category=TYPE_REFERENCE:
        BrkPdlDrvAppPrsDetcd_latched: implementation-data-type=Boolean
        BrkPedTrvlAchvd_latched: implementation-data-type=Boolean
        PT_BrkPedDscrtInpStat_latched: implementation-data-type=Boolean
        TopTrvlCltchSwAct_latched: implementation-data-type=Boolean
        Exit_For_Throttle_Override: implementation-data-type=Boolean
        Throttle_Override_Active: implementation-data-type=Boolean
        AptivHostPro_ARC: implementation-data-type=UInt8
        SysPwrMode: implementation-data-type=UInt8
        AdptCrsGapSwAct_out: implementation-data-type=UInt8
        CrsCntrlOnSwAct: implementation-data-type=Boolean
        CrsCntrlOnSwAct_n_1: implementation-data-type=Boolean
        CrsCntrlSwStCanSwAct_out: implementation-data-type=Boolean
        CrsCntrlSwStResSwAct_out: implementation-data-type=Boolean
        CrsCntrlSwStResSwAct_n_1: implementation-data-type=Boolean
        CrsCntrlSwStSetSwAct_out: implementation-data-type=Boolean
        CrsCntrlSwStSetSwAct_n_1: implementation-data-type=Boolean
        CrsCntrlSwStSpDcSwAct_out: implementation-data-type=Boolean
        CrsCntrlSwStSpDcSwAct_n_1: implementation-data-type=Boolean
        CrsCntrlSwStSpdInSwAct_out: implementation-data-type=Boolean
        CrsCntrlSwStSpdInSwAct_n_1: implementation-data-type=Boolean
        CrsCntrlSwStSwDataIntgty_out: implementation-data-type=UInt8
        CrsCntrlSwStSpDcHiSwAct: implementation-data-type=Boolean
        CrsCntrlSwStSpDcHiSwAct_n_1: implementation-data-type=Boolean
        CrsCntrlSwStSpInHiSwAct: implementation-data-type=Boolean
        CrsCntrlSwStSpInHiSwAct_n_1: implementation-data-type=Boolean
        Wiper_Status_Delayed: implementation-data-type=Boolean
        Headlamp_Status_Delayed: implementation-data-type=Boolean
        Yaw_Rate_Low_Noise: implementation-data-type=Double
        StrWhAng: implementation-data-type=Double
        StrWhAngPlusEqualsRight: implementation-data-type=Double
        GNCustSetngAvlbl: implementation-data-type=Boolean
        FCACustStngAvlbl: implementation-data-type=Boolean
        ColPrSysStngAvl: implementation-data-type=Boolean
        PedColPrSysStngAvl: implementation-data-type=Boolean
        GNCustCrntStngVal: implementation-data-type=UInt8
        ColPrSysCrntStng: implementation-data-type=UInt8
        PedColPrSysCrntStng: implementation-data-type=UInt8
        FwdClnAlrtCustCrntSetngVal: implementation-data-type=UInt8
        Host_Stopped: implementation-data-type=Boolean
        Host_Odometer_km: implementation-data-type=Double
        Host_Speed_kph: implementation-data-type=Double
        Host_Speed_Invalid: implementation-data-type=Boolean
        Host_Speed_mps: implementation-data-type=Double
        Host_Long_Accel_mpss: implementation-data-type=Double
        Host_Lat_Accel_mpss: implementation-data-type=Double
        Yaw_Rate_Compensated_Rad: implementation-data-type=Double
        Mass_X_Wheel_Radius: implementation-data-type=Double
        ACC_Low_Speed_Maneuvers: implementation-data-type=Boolean
        FCA_Low_Speed_Maneuvers: implementation-data-type=Boolean
        Cluster_Scale_Factor: implementation-data-type=Double
        Host_Speed_Meas_Rate_Limitd_Max: implementation-data-type=Boolean
        Host_Speed_Meas_Rate_Limitd_Min: implementation-data-type=Boolean
        Cluster_Offset: implementation-data-type=Double
        Road_Grade_Accel: implementation-data-type=Double
        Host_Cluster_Speed_kph: implementation-data-type=Double
        Host_Cluster_Speed_mps: implementation-data-type=Double
        VehSpdAvgNDrvn_Filt: implementation-data-type=Double
        IMULongAccelFilt_mpss: implementation-data-type=Double
        HostLongAccelFilt_mpss: implementation-data-type=Double
        Host_Rollback: implementation-data-type=Boolean
        DriverIntended_Rollback: implementation-data-type=Boolean
        Host_Speed_kph_CIB: implementation-data-type=Double
        Estimated_Radius_Curvature: implementation-data-type=Double
        HostHeading_angle: implementation-data-type=Double
        Final_filtYawRate: implementation-data-type=Double
        ExternalTJA_Active: implementation-data-type=Boolean
        speed_mps: implementation-data-type=Double
        derived_lat_accel: implementation-data-type=Double
        yaw_deg_iso_filt: implementation-data-type=Double
        steer_angle_iso: implementation-data-type=Double
        steer_angle_CR_iso: implementation-data-type=SInt16
        f_brake_pedal_inhibit: implementation-data-type=Boolean
        f_accel_pedal_inhibit: implementation-data-type=Boolean
        driver_applied_torque: implementation-data-type=Double
        driver_applied_torque_filt: implementation-data-type=Double
        f_steering_fault: implementation-data-type=Boolean
        f_steer_angle_CR_inhibit: implementation-data-type=Boolean
        PowerMode: implementation-data-type=UInt8
        IP_veh_spd_kph: implementation-data-type=Double
        LDPMode: implementation-data-type=UInt8
        LatAcceleration: implementation-data-type=Double
        LongAcceleration: implementation-data-type=Double
        Trans_in_fwd_gear: implementation-data-type=Boolean
        f_hands_on_wheel: implementation-data-type=UInt8
        f_hands_off_warning: implementation-data-type=UInt8
        f_hands_off_disable: implementation-data-type=Boolean
        LDW_ON: implementation-data-type=Boolean
        LKA_ON: implementation-data-type=Boolean
        ELK_ON: implementation-data-type=Boolean
        LCK_ON: implementation-data-type=Boolean
        ILC_ON: implementation-data-type=Boolean
        LDW_Feature_Enabled: implementation-data-type=Boolean
        LKA_Feature_Enabled: implementation-data-type=Boolean
        ELK_Feature_Enabled: implementation-data-type=Boolean
        LCK_Feature_Enabled: implementation-data-type=Boolean
        ILC_Feature_Enabled: implementation-data-type=Boolean
        LatCtrlSS_Feature_Enabled: implementation-data-type=Boolean
        MM_turn_signal_enum: implementation-data-type=UInt8
        f_left_driver_suppression: implementation-data-type=Boolean
        f_right_driver_suppression: implementation-data-type=Boolean
        TJA_Select: implementation-data-type=Boolean
        f_left_driver_suppression_elk_re: implementation-data-type=Boolean
        f_right_driver_suppression_elk_re: implementation-data-type=Boolean
        f_left_driver_suppression_elk_lct: implementation-data-type=Boolean
        f_right_driver_suppression_elk_lct: implementation-data-type=Boolean
        LSS_SnvtySet: implementation-data-type=UInt8
        yaw_rate_enable: implementation-data-type=Boolean
        f_steer_temp_inhibit: implementation-data-type=Boolean
        Camera_Fail: implementation-data-type=Boolean
        Hill_Detected: implementation-data-type=Boolean
        f_LKA_left_driver_suppression: implementation-data-type=Boolean
        f_LKA_right_driver_suppression: implementation-data-type=Boolean
        EPS_SteerMod: implementation-data-type=UInt8
        Cross_Detected: implementation-data-type=Boolean
        f_ASD_HOA: implementation-data-type=Boolean
        f_ASD_STOA: implementation-data-type=Boolean
        f_EPS_interval_req: implementation-data-type=Boolean
        SysStatusInfo: implementation-data-type=UInt8
    TP_Out: category=STRUCTURE
      190 x element, all with category=TYPE_REFERENCE:
        Ped_Movement: implementation-data-type=Ped_Movement
        Ped_Debug_Info: implementation-data-type=Ped_Debug_Info
        Ped_Tsel_AEBTgt: implementation-data-type=Ped_Tsel_AEBTgt
        Ped_Tsel_FCWTgt: implementation-data-type=Ped_Tsel_FCWTgt
        VIS_TTC_Vect: implementation-data-type=rt_Array_Double_15  # none
        VIS_CUT_IN_OUT_Vect: implementation-data-type=rt_Array_UInt8_15  # none
        VIS_LatVel_Vect: implementation-data-type=rt_Array_Double_15  # none
        VIS_LatPos_Vect: implementation-data-type=rt_Array_Double_15  # none
        VIS_LongPos_Vect: implementation-data-type=rt_Array_Double_15  # none
        VIS_OBS_Close_CUT_IN_ID: implementation-data-type=UInt8  # none
        CIPV1ObjTrackID: implementation-data-type=UInt8  # none
        CIPV1ObjRange: implementation-data-type=Double  # none
        CIPV1ObjRangeRate: implementation-data-type=Double  # none
        CIPV1ObjRangeAccel: implementation-data-type=Double  # none
        CIPV1Angle: implementation-data-type=Double  # none
        CIPV1ObjLatPos: implementation-data-type=Double  # none
        CIPV1ObjLatRate: implementation-data-type=Double  # none
        CIPV1ObjStatus: implementation-data-type=UInt8  # none
        CIPV1MRMode: implementation-data-type=UInt8  # none
        CIPV1ObjRTVisionCOnfirm: implementation-data-type=Boolean  # none
        CIPV1Far_LeftRight: implementation-data-type=UInt8  # none
        CIPV1LeftCorner_Lat: implementation-data-type=Double  # none
        CIPV1RightCorner_Lat: implementation-data-type=Double  # none
        CIPV1FarCorner_Lat: implementation-data-type=Double  # none
        CIPV1XOHP: implementation-data-type=Double  # none
        CIPV1Width: implementation-data-type=Double  # none
        CIPV1Object_Class: implementation-data-type=UInt8  # none
        CIPV2ObjTrackID: implementation-data-type=UInt8  # none
        CIPV2ObjRange: implementation-data-type=Double  # none
        CIPV2ObjRangeRate: implementation-data-type=Double  # none
        CIPV2ObjRangeAccel: implementation-data-type=Double  # none
        CIPV2Angle: implementation-data-type=Double  # none
        CIPV2ObjLatPos: implementation-data-type=Double  # none
        CIPV2ObjLatRate: implementation-data-type=Double  # none
        CIPV2ObjStatus: implementation-data-type=UInt8  # none
        CIPV2ObjRTVisionCOnfirm: implementation-data-type=Boolean  # none
        CIPV2Far_LeftRight: implementation-data-type=UInt8  # none
        CIPV2LeftCorner_Lat: implementation-data-type=Double  # none
        CIPV2RightCorner_Lat: implementation-data-type=Double  # none
        CIPV2FarCorner_Lat: implementation-data-type=Double  # none
        CIPV2XOHP: implementation-data-type=Double  # none
        CIPV2Width: implementation-data-type=Double  # none
        CIPV2Object_Class: implementation-data-type=UInt8  # none
        LftlnObjTrackID: implementation-data-type=UInt8  # none
        LftlnObjRange: implementation-data-type=Double  # none
        LftlnObjRangeRate: implementation-data-type=Double  # none
        LftlnObjRangeAccel: implementation-data-type=Double  # none
        LftlnObjAngle: implementation-data-type=Double  # none
        LftlnObjLatPos: implementation-data-type=Double  # none
        LftlnObjLatRate: implementation-data-type=Double  # none
        LftlnObjStatus: implementation-data-type=UInt8  # none
        LftlnObjRTVisionCOnfirm: implementation-data-type=Boolean  # none
        LftlnObjFar_LeftRight: implementation-data-type=UInt8  # none
        LftlnObjLeftCorner_Lat: implementation-data-type=Double  # none
        LftlnObjRightCorner_Lat: implementation-data-type=Double  # none
        LftlnObjFarCorner_Lat: implementation-data-type=Double  # none
        LftlnObjXOHP: implementation-data-type=Double  # none
        LftlnObjWidth: implementation-data-type=Double  # none
        LftlnObjObject_Class: implementation-data-type=UInt8  # none
        RtlnObjTrackID: implementation-data-type=UInt8  # none
        RtlnObjRange: implementation-data-type=Double  # none
        RtlnObjRangeRate: implementation-data-type=Double  # none
        RtlnObjRangeAccel: implementation-data-type=Double  # none
        RtlnObjAngle: implementation-data-type=Double  # none
        RtlnObjLatPos: implementation-data-type=Double  # none
        RtlnObjLatRate: implementation-data-type=Double  # none
        RtlnObjStatus: implementation-data-type=UInt8  # none
        RtlnObjRTVisionCOnfirm: implementation-data-type=Boolean  # none
        RtlnObjFar_LeftRight: implementation-data-type=UInt8  # none
        RtlnObjLeftCorner_Lat: implementation-data-type=Double  # none
        RtlnObjRightCorner_Lat: implementation-data-type=Double  # none
        RtlnObjFarCorner_Lat: implementation-data-type=Double  # none
        RtlnObjXOHP: implementation-data-type=Double  # none
        RtlnObjWidth: implementation-data-type=Double  # none
        RtlnObjObject_Class: implementation-data-type=UInt8  # none
        Lftln2ObjTrackID: implementation-data-type=UInt8  # none
        Lftln2ObjRange: implementation-data-type=Double  # none
        Lftln2ObjRangeRate: implementation-data-type=Double  # none
        Lftln2ObjRangeAccel: implementation-data-type=Double  # none
        Lftln2ObjAngle: implementation-data-type=Double  # none
        Lftln2ObjLatPos: implementation-data-type=Double  # none
        Lftln2ObjLatRate: implementation-data-type=Double  # none
        Lftln2ObjStatus: implementation-data-type=UInt8  # none
        Lftln2ObjRTVisionCOnfirm: implementation-data-type=Boolean  # none
        Lftln2ObjFar_LeftRight: implementation-data-type=UInt8  # none
        Lftln2ObjLeftCorner_Lat: implementation-data-type=Double  # none
        Lftln2ObjRightCorner_Lat: implementation-data-type=Double  # none
        Lftln2ObjFarCorner_Lat: implementation-data-type=Double  # none
        Lftln2ObjXOHP: implementation-data-type=Double  # none
        Lftln2ObjWidth: implementation-data-type=Double  # none
        Lftln2ObjObject_Class: implementation-data-type=UInt8  # none
        Rtln2ObjTrackID: implementation-data-type=UInt8  # none
        Rtln2ObjRange: implementation-data-type=Double  # none
        Rtln2ObjRangeRate: implementation-data-type=Double  # none
        Rtln2ObjRangeAccel: implementation-data-type=Double  # none
        Rtln2ObjAngle: implementation-data-type=Double  # none
        Rtln2ObjLatPos: implementation-data-type=Double  # none
        Rtln2ObjLatRate: implementation-data-type=Double  # none
        Rtln2ObjStatus: implementation-data-type=UInt8  # none
        Rtln2ObjRTVisionCOnfirm: implementation-data-type=Boolean  # none
        Rtln2ObjFar_LeftRight: implementation-data-type=UInt8  # none
        Rtln2ObjLeftCorner_Lat: implementation-data-type=Double  # none
        Rtln2ObjRightCorner_Lat: implementation-data-type=Double  # none
        Rtln2ObjFarCorner_Lat: implementation-data-type=Double  # none
        Rtln2ObjXOHP: implementation-data-type=Double  # none
        Rtln2ObjWidth: implementation-data-type=Double  # none
        Rtln2ObjObject_Class: implementation-data-type=UInt8  # none
        CIPS1ObjTrackID: implementation-data-type=UInt8  # none
        CIPS1ObjRange: implementation-data-type=Double  # none
        CIPS1ObjRangeRate: implementation-data-type=Double  # none
        CIPS1ObjRangeAccel: implementation-data-type=Double  # none
        CIPS1Angle: implementation-data-type=Double  # none
        CIPS1ObjLatPos: implementation-data-type=Double  # none
        CIPS1ObjStatus: implementation-data-type=UInt8  # none
        CIPS1ObjWidth: implementation-data-type=Double  # none
        CIPS1ObjObject_Class: implementation-data-type=UInt8  # none
        CIPS2ObjTrackID: implementation-data-type=UInt8  # none
        CIPS2ObjRange: implementation-data-type=Double  # none
        CIPS2ObjRangeRate: implementation-data-type=Double  # none
        CIPS2ObjRangeAccel: implementation-data-type=Double  # none
        CIPS2Angle: implementation-data-type=Double  # none
        CIPS2ObjLatPos: implementation-data-type=Double  # none
        CIPS2ObjStatus: implementation-data-type=UInt8  # none
        CIPS2ObjWidth: implementation-data-type=Double  # none
        CIPS2ObjObject_Class: implementation-data-type=UInt8  # none
        LftlnStatObjTrackID: implementation-data-type=UInt8  # none
        LftlnStatObjRange: implementation-data-type=Double  # none
        LftlnStatObjRangeRate: implementation-data-type=Double  # none
        LftlnStatObjRangeAccel: implementation-data-type=Double  # none
        LftlnStatObjAngle: implementation-data-type=Double  # none
        LftlnStatObjLatPos: implementation-data-type=Double  # none
        LftlnStatObjStatus: implementation-data-type=UInt8  # none
        LftlnStatObjWidth: implementation-data-type=Double  # none
        LftlnStatObjObject_Class: implementation-data-type=UInt8  # none
        RtlnStatObjTrackID: implementation-data-type=UInt8  # none
        RtlnStatObjRange: implementation-data-type=Double  # none
        RtlnStatObjRangeRate: implementation-data-type=Double  # none
        RtlnStatObjRangeAccel: implementation-data-type=Double  # none
        RtlnStatObjAngle: implementation-data-type=Double  # none
        RtlnStatObjLatPos: implementation-data-type=Double  # none
        RtlnStatObjStatus: implementation-data-type=UInt8  # none
        RtlnStatObjWidth: implementation-data-type=Double  # none
        RtlnStatObjObject_Class: implementation-data-type=UInt8  # none
        ACC_Target_Speed_mps: implementation-data-type=Double  # none
        ACC_LV_Accel_mpss: implementation-data-type=Double  # none
        ACC_LV2_Accel_mpss: implementation-data-type=Double  # none
        ACC_LV_Speed_mps: implementation-data-type=Double  # none
        ACC_LV2_Speed_mps: implementation-data-type=Double  # none
        ACC_Time_To_Collision2: implementation-data-type=Double  # none
        ACC_Target_Present: implementation-data-type=Boolean  # none
        VLowSpd_ACCEnable: implementation-data-type=UInt16  # none
        BrkPedTrvlAchvdEnable: implementation-data-type=Boolean  # none
        Allow_Engage_while_Stopped: implementation-data-type=Boolean  # none
        CloseRangeLostTarget: implementation-data-type=Boolean  # none
        ObjectDisappearing: implementation-data-type=Boolean  # none
        Path_Funnel_Offset_Left_mdl: implementation-data-type=SInt8  # none
        Path_Funnel_Offset_Right_mdl: implementation-data-type=SInt8  # none
        Outer_Funnel_State: implementation-data-type=UInt8  # none
        Target_Offset: implementation-data-type=Double  # none
        Path_Offset: implementation-data-type=Double  # none
        XOLC_From_Model: implementation-data-type=Double  # none
        Range_flickering_detected: implementation-data-type=Boolean  # none
        ACCRange: implementation-data-type=Double  # none
        ACCRangeRate: implementation-data-type=Double  # none
        ACCRAccel: implementation-data-type=Double  # none
        ACCAngle: implementation-data-type=Double  # none
        ACCTgtID: implementation-data-type=UInt8  # none
        CIPS_Alert: implementation-data-type=Boolean  # none
        Motion_Status: implementation-data-type=UInt8  # none
        MinRangeLostTarget: implementation-data-type=Boolean  # none
        Actual_Headway_Time_sec: implementation-data-type=Double  # none
        steering_angle_delta: implementation-data-type=Double  # none
        Hold_Funnel_Open: implementation-data-type=Boolean  # none
        VLowSpd_ACCResume: implementation-data-type=UInt16  # none
        Host_Trajectory_Lateral_Accel: implementation-data-type=Double  # none
        hold_funnel_open_timer: implementation-data-type=Double  # none
        LowSpeed_CutOut: implementation-data-type=Boolean  # none
        Cutin_RTID: implementation-data-type=UInt8  # none
        CutlnObj_TrackID: implementation-data-type=UInt8  # none
        CutlnObj_Range: implementation-data-type=Double  # none
        CutlnObj_RangeRate: implementation-data-type=Double  # none
        CutlnObj_RangeAccel: implementation-data-type=Double  # none
        ACC_CutIn_Speed_mps: implementation-data-type=Double  # none
        ACC_Cutin_Accel_mpss: implementation-data-type=Double  # none
        CutOut_Suspect: implementation-data-type=UInt8  # none
        AptivTgtPro_ARC: implementation-data-type=UInt8  # none
        ROC: implementation-data-type=Double  # none
        Junction_Turn_Angel: implementation-data-type=Double  # none
        DrvMode_Scenerio: implementation-data-type=UInt8  # none
        Ped_In_ROI: implementation-data-type=Boolean  # none
    Ped_Movement: category=STRUCTURE
      6 x element, all with category=TYPE_REFERENCE, implementation-data-type=Boolean:
        VRU_OC_Crossing  # none
        VRU_Proceeding  # none
        VRU_Crossing  # none
        VRU_Stop  # none
        VRU_NBSM  # none
        VRU_Moveable  # none
    Ped_Debug_Info: category=STRUCTURE
      14 x element, all with category=TYPE_REFERENCE:
        FCWPed_FID: implementation-data-type=UInt8
        CibPed_FID: implementation-data-type=UInt8
        Ped_VisVRUClutter: implementation-data-type=Boolean
        VRU_Moveable: implementation-data-type=Boolean
        VRU_NBSM: implementation-data-type=Boolean
        VRU_Stop: implementation-data-type=Boolean
        VRU_Crossing: implementation-data-type=Boolean
        VRU_Proceeding: implementation-data-type=Boolean
        VRU_OC_Crossing: implementation-data-type=Boolean
        Cur_Funnel_Thres: implementation-data-type=Double
        Pred_Funnel_Thres: implementation-data-type=Double
        CIBTgt_ReduceFlag_v: implementation-data-type=rt_Array_UInt16_12
        VRU_TSEL_Major: implementation-data-type=UInt8
        VRU_TSEL_Minor: implementation-data-type=UInt8
    rt_Array_UInt16_12: category=ARRAY
      element rt_Array_UInt16_12: array-size=12, array-size-semantics=FIXED-SIZE, implementation-data-type=UInt16
    Ped_Tsel_AEBTgt: category=STRUCTURE
      16 x element, all with category=TYPE_REFERENCE:
        CibPedTTC: implementation-data-type=Double
        CibPedVisID: implementation-data-type=UInt8
        CibPed_Lat_est: implementation-data-type=Double
        CibPed_TrackID: implementation-data-type=UInt8
        CibPedRangeRate: implementation-data-type=Double
        CibPedXPos: implementation-data-type=Double
        CibPedYPos: implementation-data-type=Double
        CibPed_Obj_Class: implementation-data-type=UInt8
        CibPed_Match_Conf: implementation-data-type=UInt8
        CibPed_DetSensor: implementation-data-type=UInt8
        CibPed_LatRate: implementation-data-type=Double
        CibPed_MovOutFun_HoldSel: implementation-data-type=Boolean
        CibPed_XOLC: implementation-data-type=Double
        CibPed_Age: implementation-data-type=UInt16
        CibPed_Oncoming: implementation-data-type=Boolean
        CibPed_LongBicyclist: implementation-data-type=Boolean
    Ped_Tsel_FCWTgt: category=STRUCTURE
      11 x element, all with category=TYPE_REFERENCE:
        FCWPed_Range: implementation-data-type=Double
        FCWPed_RangeRate: implementation-data-type=Double
        FCWPed_VisID: implementation-data-type=UInt8
        FCWPed_TrackID: implementation-data-type=UInt8
        FCWPed_Match_Conf: implementation-data-type=UInt8
        FCWPed_XOLC: implementation-data-type=Double
        FCWPed_Latrate: implementation-data-type=Double
        FCWPed_Obj_Class: implementation-data-type=UInt8
        FCWPed_Angle: implementation-data-type=Double
        FCWPed_TTC: implementation-data-type=Double
        FCWPed_Age: implementation-data-type=UInt16
    rt_Array_Double_15: category=ARRAY
      element rt_Array_Double_15: array-size=15, array-size-semantics=FIXED-SIZE, implementation-data-type=Double
    rt_Array_UInt8_15: category=ARRAY
      element rt_Array_UInt8_15: array-size=15, array-size-semantics=FIXED-SIZE, implementation-data-type=UInt8
    AEB_Out: category=STRUCTURE
      12 x element, all with category=TYPE_REFERENCE:
        AEB_Trigger_Alert: implementation-data-type=Boolean
        AEB_BrkPrfReq: implementation-data-type=Boolean
        ABA_ReqActive: implementation-data-type=Boolean
        ABA2_ReqActive: implementation-data-type=Boolean
        AEB_CtrlAcc: implementation-data-type=Double
        AEB_MinusDecelActive: implementation-data-type=Boolean
        AEB_AutoBrkWithPrefill_Avitve: implementation-data-type=Boolean
        AEB_AutoBrkReqTyp: implementation-data-type=UInt8
        AEB_Dev_Logger: implementation-data-type=AEB_Dev_Logger
        VRUBrakeActive: implementation-data-type=Boolean
        VRUAlertRequest: implementation-data-type=Boolean
        AEB_ARC: implementation-data-type=UInt8
    AEB_Dev_Logger: category=STRUCTURE
      73 x element, all with category=TYPE_REFERENCE:
        Time_To_Turn: implementation-data-type=Double
        Time_To_Brake: implementation-data-type=Double
        Time_To_Collision: implementation-data-type=Double
        CIP_ID: implementation-data-type=UInt8
        CIP_Range: implementation-data-type=Double
        CIP_RangeRate: implementation-data-type=Double
        CIP_LatPos: implementation-data-type=Double
        CIP_RangeAccel: implementation-data-type=Double
        CIP_Movement: implementation-data-type=UInt8
        CIP_Match_Conf: implementation-data-type=UInt8
        CIP_DetSensor: implementation-data-type=UInt8
        CIP_Class: implementation-data-type=UInt8
        CIP_LatRate: implementation-data-type=Double
        CIP_Moveable: implementation-data-type=Boolean
        Traget_XOLC: implementation-data-type=Double
        CibPed_Lat_est: implementation-data-type=Double
        Last_Brake_Age: implementation-data-type=UInt16
        Target_Width: implementation-data-type=Double
        FltVehicleSpeed: implementation-data-type=Double
        FltAccel: implementation-data-type=Double
        DrvEngage: implementation-data-type=UInt8
        Override: implementation-data-type=Boolean
        GasPedalOR: implementation-data-type=Boolean
        SteeringOR: implementation-data-type=Boolean
        IMULonAccPri: implementation-data-type=Double
        BrkPedRateUnfilt: implementation-data-type=Double
        DrvAppdBrkPrsRateUnfilt: implementation-data-type=Double
        BrakePedalActive: implementation-data-type=Boolean
        BrakePressureActive: implementation-data-type=Boolean
        HighBrakeTimer: implementation-data-type=UInt16
        FullBrakeTimer: implementation-data-type=UInt16
        PCSAlgorithmCounter: implementation-data-type=UInt32
        NewTrackDataCounter: implementation-data-type=UInt32
        ForEachTrackCounter: implementation-data-type=UInt32
        ProcessCIP: implementation-data-type=UInt32
        TOIDiscrimination: implementation-data-type=UInt32
        Diag_BrakeDiscrimination: implementation-data-type=UInt32
        Diag_HighBrakeCounter: implementation-data-type=UInt32
        Diag_LowBrakeCounter: implementation-data-type=UInt32
        Diag_PrefillCounter: implementation-data-type=UInt32
        Diag_FLBACounter: implementation-data-type=UInt32
        Diag_MinStopCounter: implementation-data-type=UInt32
        Diag_IBACounter: implementation-data-type=UInt32
        Diag_FullCounter: implementation-data-type=UInt32
        ReleaseBrakeCommand: implementation-data-type=UInt8
        PCS_BrakeRequestLevel: implementation-data-type=UInt8
        TA_ABA_Req: implementation-data-type=Boolean
        TA_ABA2_Req: implementation-data-type=Boolean
        BrakeRequestAccel: implementation-data-type=Double
        BrakeRequestValid: implementation-data-type=Boolean
        BrakePrefill: implementation-data-type=Boolean
        ABA_Req: implementation-data-type=Boolean
        ABA2_Req: implementation-data-type=Boolean
        NeededDecel: implementation-data-type=Double
        Min_DecelRequest: implementation-data-type=Double
        UsePed: implementation-data-type=Boolean
        Low_Brake_Annoying: implementation-data-type=Double
        LowBrakeAccelOffset: implementation-data-type=Double
        HighBrakeAccelOffset: implementation-data-type=Double
        Prefill_Thres: implementation-data-type=Double
        Low_Brake_Thres: implementation-data-type=Double
        High_Brake_Thres: implementation-data-type=Double
        Junction_Case: implementation-data-type=UInt8
        ColPrSysCrntStng: implementation-data-type=UInt8
        PedColPrSysCrntStng: implementation-data-type=UInt8
        ABA_Flag: implementation-data-type=UInt16
        Prefill_Flag: implementation-data-type=UInt16
        LowBrake_Flag: implementation-data-type=UInt16
        HighBrake_Flag: implementation-data-type=UInt16
        FullBrake_Flag: implementation-data-type=UInt16
        IBA_Flag: implementation-data-type=UInt16
        Major_Version_AEB: implementation-data-type=UInt8
        Minor_Version_AEB: implementation-data-type=UInt8
package /CIB_SWC_pkg/CIB_SWC_dt/SwAddrMethods
  sw addr method CODE: section-type=CODE
  sw addr method CONST: section-type=CONST
  sw addr method VAR: section-type=VAR
