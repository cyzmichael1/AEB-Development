AUTOSAR XML (schema 4-3-0)
package /CIB_SWC_pkg/CIB_SWC_imp
  swc implementation CIB_SWC: programming-language=C, sw-version=1.148.1, used-code-generator=Embedded Coder 7.1 (R2018b) 24-May-2018, vendor-id=0, behavior=CIB_SWC
    code-descriptors:
      code Code
        artifact-descriptors:
          short-label=AEB_Lib_c, category=SWSRC
          short-label=AEB_Lib_data_c, category=SWSRC
          short-label=CIB_SWC_c, category=SWSRC
          short-label=binsearch_u32d_c, category=SWSRC
          short-label=const_params_c, category=SWSRC
          short-label=look1_binlcapw_c, category=SWSRC
          short-label=look1_linlcapw_c, category=SWSRC
          short-label=look2_linlcapw_c, category=SWSRC
          short-label=plook_u32d_bincka_c, category=SWSRC
          short-label=plook_u32d_binckan_c, category=SWSRC
          short-label=AEB_Lib_h, category=SWHDR
          short-label=AEB_Lib_private_h, category=SWHDR
          short-label=AEB_Lib_types_h, category=SWHDR
          short-label=CIB_SWC_h, category=SWHDR
          short-label=CIB_SWC_private_h, category=SWHDR
          short-label=CIB_SWC_types_h, category=SWHDR
          short-label=binsearch_u32d_h, category=SWHDR
          short-label=look1_binlcapw_h, category=SWHDR
          short-label=look1_linlcapw_h, category=SWHDR
          short-label=look2_linlcapw_h, category=SWHDR
          short-label=plook_u32d_bincka_h, category=SWHDR
          short-label=plook_u32d_binckan_h, category=SWHDR
          short-label=rtwtypes_h, category=SWHDR
    resource consumption RsrcCons_CIB_SWC
