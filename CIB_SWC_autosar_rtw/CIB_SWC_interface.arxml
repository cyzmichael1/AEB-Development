AUTOSAR XML (schema 4-3-0)
package /CIB_SWC_pkg/CIB_SWC_if
  9 x sender receiver interface:
    enable_inhibit_latch
      data enable_inhibit_latch: category=STRUCTURE, sw-calibration-access=READ-ONLY, type=Diag
    Vehicle_Control
      data Vehicle_Control: category=STRUCTURE, sw-calibration-access=READ-ONLY, type=ACC
    From_VCAN
      data From_VCAN: category=STRUCTURE, sw-calibration-access=READ-ONLY, type=VCAN
    From_HandCode
      data From_HandCode: category=STRUCTURE, sw-calibration-access=READ-ONLY, type=HandCode_To_AEB
    Tracks_of_Interest
      data Tracks_of_Interest: category=STRUCTURE, sw-calibration-access=READ-ONLY, type=target_of_interest
    proc_input_signals
      data proc_input_signals: category=STRUCTURE, sw-calibration-access=READ-ONLY, type=HSP
    Host_Vehicle_State
      data Host_Vehicle_State: category=STRUCTURE, sw-calibration-access=READ-ONLY, type=HSP
    Fusion_VRU
      data Fusion_VRU: category=STRUCTURE, sw-calibration-access=READ-ONLY, type=TP_Out
    AEB_Out
      data AEB_Out: category=STRUCTURE, sw-calibration-access=READ-ONLY, type=AEB_Out
